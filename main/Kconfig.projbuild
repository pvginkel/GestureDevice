## main/Kconfig.projbuild
```kconfig
menu "Device Configuration"

    orsource "$IDF_PATH/examples/common_components/env_caps/$IDF_TARGET/Kconfig.env_caps"

    config DEVICE_LDR_PIN
        int "Light dependent resistor pin"
        default -1

    config DEVICE_INT_PIN
        int "SEN0626 interrupt pin"
        default -1

    config DEVICE_SDA_PIN
        int "SEN0626 SDA pin"
        default -1

    config DEVICE_SCL_PIN
        int "SEN0626 SCL pin"
        default -1

    config DEVICE_LDR_SENSOR_REPORT_INTERVAL_MS
        int "Light dependent resistor report interval in ms"
        default 10000

endmenu
```

## sdkconfig.defaults
```kconfig
# Application configuration

CONFIG_DEVICE_LDR_PIN=1
CONFIG_DEVICE_INT_PIN=2
CONFIG_DEVICE_SDA_PIN=3
CONFIG_DEVICE_SCL_PIN=4

CONFIG_IDF_TARGET="esp32s3"

# Setup flash

CONFIG_ESPTOOLPY_FLASHSIZE_4MB=y
CONFIG_PARTITION_TABLE_CUSTOM=y

# SPIRAM

CONFIG_SPIRAM=y
CONFIG_SPIRAM_FETCH_INSTRUCTIONS=y
CONFIG_SPIRAM_RODATA=y
CONFIG_SPIRAM_SPEED_80M=y

# Status led

CONFIG_STATUS_LED_WS2812_PIN=38

# MQTT

CONFIG_MQTT_TOPIC_PREFIX="gesture_device"
CONFIG_MQTT_DEVICE_MANUFACTURER="Pieter"
CONFIG_MQTT_DEVICE_MODEL="Gesture Device"
CONFIG_MQTT_DEVICE_MODEL_ID="Gesture Device v1"
```
